/dts-v1/;
/plugin/;

&{/} {
    fragment@0 {
        target = <&i2c1>;
        __overlay__ {
            tcs34725@29 {
                compatible = "taos,tcs34725";
                reg = <0x29>;
            };
        };
    };
};
// 0x29 is the default I2C address of the TCS34725.